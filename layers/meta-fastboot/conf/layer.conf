## layers/meta-iaca/conf/distro/iaca-os.conf
```bitbake
# IACA OS Distribution Configuration
# This file defines the iaca-os distribution

# Distro identification
DISTRO = "iaca-os"
DISTRO_NAME = "IACA OS"
DISTRO_VERSION = "1.0"
DISTRO_CODENAME = "scarthgap"

# Image configuration
IMAGE_CLASSES += "image_types_iaca image_types_dir"

IMAGE_FSTYPES = "rpi-sdimg tar.gz dir iaca"
BOOT_SPACE = "128000"

# Kernel and hardware support
ENABLE_I2C = "1"
KERNEL_MODULE_AUTOLOAD += " i2c-dev i2c-bcm2708 i2c-designware-core"

# Package installation
IMAGE_INSTALL:append = " kernel-modules"
IMAGE_INSTALL:append = " bash raspi-utils util-linux hello-rust rust-hello-mod colors i2c-tools"
IMAGE_INSTALL:append = " iaca-watchdog"

# Rust configuration
PREFERRED_VERSION_linux-raspberrypi = "6.12.%"
RUST_KERNEL_TOOLCHAIN = "/home/user/.rustup/toolchains/1.78.0-x86_64-unknown-linux-gnu"
RUST_KERNEL_BINDGEN_DIR = "/home/user/rust-kernel-tools/bin"
```

## work/conf/bblayers.conf
```bitbake
# POKY_BBLAYERS_CONF_VERSION is increased each time build/conf/bblayers.conf
# changes incompatibly
POKY_BBLAYERS_CONF_VERSION = "2"

BBPATH = "${TOPDIR}"
BBFILES ?= ""

BBLAYERS ?= " \
  ${TOPDIR}/../poky/meta \
  ${TOPDIR}/../poky/meta-poky \
  ${TOPDIR}/../poky/meta-yocto-bsp \
  ${TOPDIR}/../layers/meta-raspberry \
  ${TOPDIR}/../layers/meta-openembedded/meta-oe \
  ${TOPDIR}/../layers/meta-iaca \
  ${TOPDIR}/../layers/meta-openembedded/meta-python \
  ${TOPDIR}/../layers/meta-arm/meta-arm-toolchain \
  ${TOPDIR}/../layers/meta-arm/meta-arm \
  ${TOPDIR}/../layers/meta-sunxi \
  "
```
